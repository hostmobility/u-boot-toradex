/*
 * Copyright 2017 Host Mobility AB
 *
 * SPDX-License-Identifier:     GPL-2.0+ or X11
 */

/dts-v1/;
#include "vf-colibri.dtsi"

/ {
	model = "Toradex Colibri VF61";
	compatible = "toradex,vf610-colibri_vf61", "toradex,vf610-colibri_vf61", "fsl,vf610";
};

&ehci0 {
	dr_mode = "host";
};
