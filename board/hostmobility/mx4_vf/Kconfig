## board/hostmobility/mx4_vf/Kconfig
```kconfig
if TARGET_MX4_VF

config SYS_CPU
	default "armv7"

config SYS_BOARD
	default "mx4_vf"

config SYS_VENDOR
	default "hostmobility"

config SYS_SOC
	default "vf610"

config SYS_CONFIG_NAME
	default "mx4_vf"

endif
```

## board/toradex/mx4_tegra2/Kconfig
```kconfig
if TARGET_MX4_T20

config SYS_BOARD
	default "mx4_tegra2"

config SYS_VENDOR
	default "toradex"

config SYS_CONFIG_NAME
	default "mx4_t20"

endif

if TARGET_MX4_MIL

config SYS_BOARD
	default "mx4_tegra2"

config SYS_VENDOR
	default "toradex"

config SYS_CONFIG_NAME
	default "mx4_mil"

endif

if TARGET_MX4_MIL_SE

config SYS_BOARD
	default "mx4_tegra2"

config SYS_VENDOR
	default "toradex"

config SYS_CONFIG_NAME
	default "mx4_mil_se"

endif

if TARGET_MX4_CT

config SYS_BOARD
	default "mx4_tegra2"

config SYS_VENDOR
	default "toradex"

config SYS_CONFIG_NAME
	default "mx4_ct"

endif
```

## board/toradex/mx4_vf/Kconfig
```kconfig
if TARGET_MX4_V61

config SYS_CPU
	default "armv7"

config SYS_BOARD
	default "mx4_vf"

config SYS_VENDOR
	default "toradex"

config SYS_SOC
	default "vf610"

config TDX_CFG_BLOCK
	default y

config TDX_HAVE_NAND
	default y

config TDX_CFG_BLOCK_OFFSET
	default "2048"

config TDX_CFG_BLOCK_2ND_ETHADDR
	default y

config SYS_CONFIG_NAME
	default "mx4_v61"

source "board/toradex/common/Kconfig"

endif

if TARGET_MX4_C61

config SYS_CPU
	default "armv7"

config SYS_BOARD
	default "mx4_vf"

config SYS_VENDOR
	default "toradex"

config SYS_SOC
	default "vf610"

config TDX_CFG_BLOCK
	default y

config TDX_HAVE_NAND
	default y

config TDX_CFG_BLOCK_OFFSET
	default "2048"

config TDX_CFG_BLOCK_2ND_ETHADDR
	default y

config SYS_CONFIG_NAME
	default "mx4_c61"

source "board/toradex/common/Kconfig"

endif
```

## configs/mx4_c61_defconfig
```kconfig
CONFIG_ARM=y
CONFIG_ARCH_VF610=y
CONFIG_DM_SERIAL=y
CONFIG_TARGET_MX4_C61=y
CONFIG_IMX_BOOTAUX=y
CONFIG_DEFAULT_DEVICE_TREE="vf610-mx4-c61"
CONFIG_SYS_EXTRA_OPTIONS="IMX_CONFIG=board/toradex/mx4_vf/imximage.cfg,ENV_IS_IN_NAND,IMX_NAND"
CONFIG_BOOTDELAY=0
CONFIG_VERSION_VARIABLE=y
# CONFIG_DISPLAY_BOARDINFO is not set
CONFIG_HUSH_PARSER=y
CONFIG_SYS_PROMPT="MX-4 C61 # "
CONFIG_CMD_BOOTZ=y
# CONFIG_CMD_IMLS is not set
CONFIG_CMD_ASKENV=y
CONFIG_CMD_MEMTEST=y
CONFIG_CMD_MMC=y
CONFIG_CMD_SPI=y
CONFIG_CMD_USB=y
CONFIG_CMD_GPIO=y
# CONFIG_CMD_SETEXPR is not set
CONFIG_CMD_DHCP=y
CONFIG_CMD_MII=y
CONFIG_CMD_PING=y
CONFIG_CMD_EXT4=y
CONFIG_CMD_FAT=y
CONFIG_CMD_FS_GENERIC=y
CONFIG_CMD_UBI=y
CONFIG_CMD_UBIFS=y
CONFIG_OF_CONTROL=y
CONFIG_DM=y
CONFIG_DM_GPIO=y
CONFIG_VYBRID_GPIO=y
CONFIG_NAND_VF610_NFC=y
CONFIG_SYS_NAND_VF610_NFC_60_ECC_BYTES=y
CONFIG_MTD_UBI_FASTMAP=y
CONFIG_FSL_LPUART=y
CONFIG_DM_SPI=y
CONFIG_FSL_DSPI=y
CONFIG_USB=y
CONFIG_DM_USB=y
CONFIG_USB_STORAGE=y
CONFIG_OF_LIBFDT_OVERLAY=y
# CONFIG_EFI_LOADER is not set
```

## configs/mx4_t30_defconfig
```kconfig
CONFIG_ARM=y
CONFIG_TEGRA=y
CONFIG_TEGRA30=y
CONFIG_TARGET_MX4_T30=y
CONFIG_DEFAULT_DEVICE_TREE="tegra30-colibri"
CONFIG_OF_SYSTEM_SETUP=y
CONFIG_BOOTDELAY=0
CONFIG_SYS_STDIO_DEREGISTER=y
CONFIG_VERSION_VARIABLE=y
# CONFIG_DISPLAY_BOARDINFO is not set
CONFIG_HUSH_PARSER=y
CONFIG_SYS_PROMPT="MX-4 T30 # "
CONFIG_CMD_BOOTZ=y
# CONFIG_CMD_IMI is not set
# CONFIG_CMD_IMLS is not set
CONFIG_CMD_ASKENV=y
CONFIG_CMD_MEMTEST=y
# CONFIG_CMD_FLASH is not set
CONFIG_CMD_MMC=y
CONFIG_CMD_SPI=y
CONFIG_TEGRA_SPI=y
CONFIG_TEGRA_SLINK=y
CONFIG_DM_SPI=y
CONFIG_CMD_I2C=y
CONFIG_CMD_USB=y
# CONFIG_CMD_FPGA is not set
CONFIG_CMD_GPIO=y
CONFIG_CMD_DHCP=y
# CONFIG_CMD_NFS is not set
CONFIG_CMD_MII=y
CONFIG_CMD_PING=y
CONFIG_CMD_EXT2=y
CONFIG_CMD_EXT4=y
CONFIG_CMD_EXT4_WRITE=y
CONFIG_CMD_FAT=y
CONFIG_CMD_FS_GENERIC=y
CONFIG_SPL_DM=y
# CONFIG_BLK is not set
# CONFIG_DM_MMC_OPS is not set
CONFIG_TEGRA_MMC=y
CONFIG_DM_REGULATOR=y
CONFIG_DM_REGULATOR_FIXED=y
CONFIG_PWM_TEGRA=y
CONFIG_SYS_NS16550=y
CONFIG_TEGRA20_SLINK=y
CONFIG_USB=y
CONFIG_DM_USB=y
CONFIG_USB_STORAGE=y
CONFIG_DM_VIDEO=y
CONFIG_VIDEO_TEGRA20=y
CONFIG_CONSOLE_SCROLL_LINES=10
CONFIG_OF_LIBFDT_OVERLAY=y
```

## configs/mx4_vf_defconfig
```kconfig
CONFIG_SYS_EXTRA_OPTIONS="IMX_CONFIG=board/hostmobility/mx4_vf/imximage.cfg,ENV_IS_IN_NAND,IMX_NAND"
CONFIG_ARM=y
CONFIG_TARGET_MX4_VF=y
```

## t20/utils/create_oe_rootfs/stuff/meta-toradex/conf/machine/colibri-t20.conf
```bitbake
#@TYPE: Machine
#@NAME: colibri_t20
#@DESCRIPTION: Toradex Colibri T20

SOC_FAMILY = "tegra:tegra2"
require conf/machine/include/soc-family.inc

PREFERRED_PROVIDER_virtual/kernel = "linux-toradex"

KERNEL_IMAGETYPE = "uImage"
UBOOT_MACHINE = "colibri_t20_config"
UBOOT_ENTRYPOINT = "0x00008000"

PREFERRED_PROVIDER_virtual/xserver = "xserver-xorg"
PREFERRED_VERSION_xserver-xorg_tegra = "99:1.14%"
XSERVER = "xserver-xorg \
           xf86-input-evdev \
           xf86-input-mouse \
           xf86-video-fbdev \
           xf86-input-keyboard"
# Only has DVI connector for external screen, name is changing to MACHINE_GUI_CLASS
GUI_MACHINE_CLASS = "bigscreen"
MACHINE_GUI_CLASS = "bigscreen"

PREFERRED_PROVIDER_lxde-icon-theme_tegra = "lxde-icon-theme"
PREFERRED_PROVIDER_lxsession-lite_tegra = "lxsession"
PREFERRED_PROVIDER_virtual/psplash = "psplash-angstrom"
PREFERRED_PROVIDER_psplash-support = "psplash-angstrom"

PREFERRED_PROVIDER_virtual/mesa = "mesa"
PREFERRED_PROVIDER_virtual/egl = "trdx-nv-binaries"
PREFERRED_PROVIDER_virtual/libgles1 = "trdx-nv-binaries"
PREFERRED_PROVIDER_virtual/libgles2 = "trdx-nv-binaries"

MACHINE_FEATURES = "kernel26 screen usbgadget usbhost vfat ext2 alsa touchscreen ethernet"
EXTRA_IMAGEDEPENDS += "u-boot"

# used by sysvinit_2
SERIAL_CONSOLE = "115200 ttyS0"
IMAGE_FSTYPES ?= "tar.bz2"

# T20 does not have neon
DEFAULTTUNE = "armv7ahf"
#choose a specific vfp, or we end up with the default vfpv2 optimization
TUNE_CCARGS += "-mfpu=vfpv3-d16"
require conf/machine/include/tune-cortexa9.inc
```
